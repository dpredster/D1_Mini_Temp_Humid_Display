/**
	* Name: EE_D1_TempHumidDisplay_w_Icon.ino
	* Version: 1.0.0
	* Creation Date:09/10/2020
	* Author: David Preddie (dpredster)
	* Description:
	* This sketch use Wemos D1 Mini(ESP8266), BME280 Temperature Humidity Pressure Sensor to read 
	* the temperature, pressure, humidity and altitude and display the readings on a 0.96 inch OLED Display.
	* It shows the use of icons in the program. You can convert your images to hex using the online tool
	* at http://javl.github.io/image2cpp/
	* The sketch was developed for Sheridan College Electronic Enabling Club.
*/

// Libraries required for the BME280 Temperature Humidity Pressure Sensor
#include <Wire.h>
#include <Adafruit_Sensor.h>
#include <Adafruit_BME280.h>

// Libraries required for the 0.96 inch OLED Display
#include <Adafruit_GFX.h>
#include <Adafruit_SSD1306.h>


#define SEALEVELPRESSURE (1013.25) // Defines seal level pressure in millibars
#define SCREEN_WIDTH 128 // Defines OLED display width, in pixels
#define SCREEN_HEIGHT 64 // Defines OLED display height, in pixels

// Declaration for BME280 connected to I2C
Adafruit_BME280 bme;
// Declaration for SSD1306 display connected to I2C (SDA, SCL pins)
Adafruit_SSD1306 display(SCREEN_WIDTH, SCREEN_HEIGHT, &Wire, -1);

unsigned long delayTime; // Define delay time

// Thermometer icon, 32x32px
const unsigned char temperature[] PROGMEM = {
    0x00, 0x0f, 0x00, 0x00, 0x00, 0x1b, 0x80, 0x00, 0x00, 0x30, 0x80, 0x00, 0x00, 0x30, 0x80, 0x00,
    0x00, 0x30, 0x8f, 0x80, 0x00, 0x30, 0x80, 0x00, 0x00, 0x30, 0x80, 0x00, 0x00, 0x30, 0x8e, 0x00,
    0x00, 0x30, 0x80, 0x00, 0x00, 0x30, 0x80, 0x00, 0x00, 0x30, 0x8f, 0x80, 0x00, 0x30, 0x80, 0x00,
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0x00, 0x9f, 0xb0, 0x00, 0x00, 0xc4, 0x60, 0x00, 0x00, 0x39, 0xc0, 0x00, 0x00, 0x1f, 0x00, 0x00};

// Humidity icon, 32x32px
const unsigned char humidity[] PROGMEM = {
    0x00, 0x00, 0x00, 0x00, 0x00, 0x00, 0x00, 0x00, 0x00, 0x01, 0x80, 0x00, 0x00, 0x03, 0xc0, 0x00,
    0x00, 0x07, 0xe0, 0x00, 0x00, 0x0f, 0xf0, 0x00, 0x00, 0x1f, 0xf8, 0x00, 0x00, 0x3f, 0xfc, 0x00,
    0x00, 0x3f, 0xfc, 0x00, 0x00, 0x7f, 0xfe, 0x00, 0x00, 0xff, 0xff, 0x00, 0x01, 0xff, 0xff, 0x80,
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0x00, 0x7f, 0xfe, 0x00, 0x00, 0x1f, 0xf8, 0x00, 0x00, 0x03, 0x80, 0x00, 0x00, 0x00, 0x00, 0x00};

// Pressure icon, 32x32px
const unsigned char pressure [] PROGMEM = {
	0x00, 0x0f, 0xf0, 0x00, 0x00, 0x7f, 0xfe, 0x00, 0x01, 0xff, 0xff, 0x80, 0x03, 0xf0, 0x0f, 0xc0, 
	0x07, 0xe0, 0x07, 0xe0, 0x0f, 0x30, 0x0c, 0xf0, 0x1e, 0x00, 0x00, 0x78, 0x3c, 0x01, 0x80, 0x3c, 
	0x3c, 0x01, 0x80, 0x3c, 0x7e, 0x01, 0x80, 0x7e, 0x70, 0x01, 0x80, 0x0e, 0x70, 0x03, 0x80, 0x0e, 
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	0x03, 0xf0, 0x0f, 0xc0, 0x01, 0xff, 0xff, 0x80, 0x00, 0x7f, 0xfe, 0x00, 0x00, 0x0f, 0xf0, 0x00
};

// Altitude icon, 32x32px
const unsigned char altitude [] PROGMEM = {
	0x00, 0x00, 0x00, 0x00, 0x00, 0x00, 0x00, 0x00, 0x00, 0x00, 0x00, 0x00, 0x00, 0x00, 0x00, 0x00, 
	0x00, 0x00, 0x00, 0x00, 0x00, 0x00, 0x00, 0x00, 0x00, 0x00, 0x10, 0x00, 0x00, 0x00, 0x38, 0x00, 
	0x00, 0x00, 0x38, 0x00, 0x00, 0x00, 0x7c, 0x00, 0x00, 0x00, 0x7c, 0x00, 0x00, 0x60, 0xee, 0x00, 
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	0x00, 0x00, 0x00, 0x00, 0x00, 0x00, 0x00, 0x00, 0x00, 0x00, 0x00, 0x00, 0x00, 0x00, 0x00, 0x00
};


// Function to return temperature reading
String readBME280Temperature() {
	float t = bme.readTemperature();
	if (isnan(t)) {    
		Serial.println("Failed to read from BME28 sensor");
		return "--";
	}
	else {
		Serial.print("Temperature = ");
		Serial.print(t);
		return String(t);
	}
}
// Function to return humidity reading
String readBME280Humidity() {
	float h = bme.readHumidity();
	if (isnan(h)) {    
		Serial.println("Failed to read from BME28 sensor");
		return "--";
	}
	else {
		Serial.print("Humidity = ");
		Serial.print(h);
		return String(h);
	}
}
// Function to return pressure reading
String readBME280Pressure() {
	float p = bme.readPressure() / 100.0F;
	if (isnan(p)) {    
		Serial.println("Failed to read from BME28 sensor");
		return "--";
	}
	else {
		Serial.print("Pressure = ");
		Serial.print(p);
		return String(p);
	}
}
// Function to return approximate altitude reading
String readBME280Altitude() {
	float a = bme.readAltitude(SEALEVELPRESSURE);
	if (isnan(a)) {    
		Serial.println("Failed to read from BME28 sensor");
		return "--";
	}
	else {
		Serial.print("Approx. Altitude = ");
		Serial.print(a);
		return String(a);
	}
}

// Function to display icon and readings
void displayInfo(String title, String reading) {
	
	// Display icon based on the title
	if (title == "Temperature") {
		display.drawBitmap(33, 0, temperature, 32, 32, WHITE);		
	}
	else if (title == "Humidity") {
		display.drawBitmap(33, 0, humidity, 32, 32, WHITE);
	}
	else if (title == "Pressure") {
		display.drawBitmap(33, 0, pressure, 32, 32, WHITE);
	}
	else if (title == "Altitude") {
		display.drawBitmap(33, 0, altitude, 32, 32, WHITE);
	}	
	display.setTextSize(2);
	display.setTextColor(WHITE);
	display.setCursor(0, 45);
	display.println(reading);
	display.display();
	display.clearDisplay();
}

void setup() {
	Serial.begin(115200);
	
	unsigned status;
	status = bme.begin(0x76); // I2C address of BME280
	if (!status) {
		Serial.println("BME280 sensor not found.");
		while (1);
	}
	
	if(!display.begin(SSD1306_SWITCHCAPVCC, 0x3C)) { // I2C address for SSD1306 display
		Serial.println(F("SSD1306 allocation failed"));
		for(;;);
	}
	
	// Clear the buffer
	display.clearDisplay();
	
	// Boot message
	display.setTextSize(2);
	display.setTextColor(WHITE);
	display.setCursor(0, 0);
	display.println("Welcome to");
	display.println("Electronic");
	display.println("Enabling");
	display.println("Club");
	display.display();
	delay(10000);	
	display.clearDisplay();
	
	// Set delay time (15000 = 15 sec)
	delayTime = 15000;	
}

void loop() {
	
	// Read temperature, humidity and pressure for display
	String temperatureReading = readBME280Temperature() + + " " + char(247) + "C";
	String humidityReading = readBME280Humidity()  + " %";
	String pressureReading = readBME280Pressure() + " hPa";
String altitudeReading = readBME280Altitude()  + " m";

// Passing values to display function and delay.
displayInfo("Temperature", temperatureReading);
delay(delayTime);
displayInfo("Humidity", humidityReading);
delay(delayTime);
displayInfo("Pressure", pressureReading);
delay(delayTime);
displayInfo("Altitude", altitudeReading);
delay(delayTime);
}
